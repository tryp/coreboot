## src/cpu/intel/fsp_haswell/Kconfig
```kconfig
config CPU_INTEL_FSP_HASWELL
	bool

if CPU_INTEL_FSP_HASWELL

config CPU_SPECIFIC_OPTIONS
	def_bool y
	select ARCH_BOOTBLOCK_X86_32
	select ARCH_ROMSTAGE_X86_32
	select ARCH_RAMSTAGE_X86_32
	select BACKUP_DEFAULT_SMM_REGION
	select SMP
	select MMX
	select SSE
	select SSE2
	select UDELAY_TSC
	#select UDELAY_LAPIC
	select TSC_CONSTANT_RATE
	select SMM_TSEG
	select RELOCATABLE_MODULES
	select RELOCATABLE_RAMSTAGE
	select DYNAMIC_CBMEM
	select BROKEN_CAR_MIGRATE
	select SUPPORT_CPU_UCODE_IN_CBFS
	#select AP_IN_SIPI_WAIT
	select TSC_SYNC_MFENCE
	select LAPIC_MONOTONIC_TIMER
	#select CPU_INTEL_FIRMWARE_INTERFACE_TABLE
	select PARALLEL_CPU_INIT
	select PARALLEL_MP

config SERIAL_CPU_INIT
	bool
	default n

config SMM_TSEG_SIZE
	hex
	default 0x800000

config ENABLE_VMX
	bool "Enable VMX for virtualization"
	default n

config IED_REGION_SIZE
	hex
	default 0x400000

config SMM_RESERVED_SIZE
	hex
	default 0x100000

config RESET_ON_INVALID_RAMSTAGE_CACHE
	bool "Reset the system on S3 wake when ramstage cache invalid."
	default n
	depends on RELOCATABLE_RAMSTAGE
	help
	  The haswell romstage code caches the loaded ramstage program
	  in SMM space. On S3 wake the romstage will copy over a fresh
	  ramstage that was cached in the SMM space. This option determines
	  the action to take when the ramstage cache is invalid. If selected
	  the system will reset otherwise the ramstage will be reloaded from
	  cbfs.

config MONOTONIC_TIMER_MSR
	def_bool n
	depends on INTEL_LYNXPOINT_LP
	select HAVE_MONOTONIC_TIMER
	help
	  Provide a monotonic timer using the 24MHz MSR counter.

config HAVE_FSP
	bool "Add a FSP  binary"
	help
	  Select this option to add a System Agent binary to
	  the resulting coreboot image.

	  Note: Without this binary coreboot will not work

config FSP_FILE
	string "Intel System Agent path and filename"
	depends on HAVE_FSP
	default "3rdparty/blobs/mainboard/$(MAINBOARDDIR)/fsp.bin"
	help
	  The path and filename of the file to use as System Agent
	  binary.

config FSP_LOCATION
	hex "Intel System Agent binary location in cbfs"
	depends on HAVE_FSP
	default 0xfff60000
	help
	  The location in cbfs that the Intel System Agent binary is
	  located. Be careful if you change this location.

config CPU_MICROCODE_FILE
	string "Microcode file path and filename"
	depends on CPU_MICROCODE_IN_CBFS && CPU_MICROCODE_CBFS_GENERATE
	default "microcode_blob.c"
	help
	  The path and filename of the file to use as microcode
	  file.

config CPU_MICROCODE_CBFS_LOC
	hex
	depends on SUPPORT_CPU_UCODE_IN_CBFS
	default 0xfff50040
	help
	  The location in cbfs that the microcode binary is
	  located. Be careful if you change this location.

endif
```

## src/mainboard/orion/vpx7664_fsp/Kconfig
```kconfig
if BOARD_ORION_VPX7664_FSP

config BOARD_SPECIFIC_OPTIONS # dummy
	def_bool y
	select ARCH_X86
	select NORTHBRIDGE_INTEL_FSP_HASWELL
	select SOUTHBRIDGE_INTEL_LYNXPOINT
	select BOARD_ROMSIZE_KB_8192
	select HAVE_ACPI_TABLES
	select HAVE_OPTION_TABLE
	select HAVE_SMI_HANDLER
	select INTEL_INT15

config MAINBOARD_DIR
	string
	default orion/vpx7664_fsp

config MAINBOARD_PART_NUMBER
	string
	default "VPX7664"

config MMCONF_BASE_ADDRESS
	hex
	default 0xf0000000

config IRQ_SLOT_COUNT
	int
	default 18

config MAX_CPUS
	int
	default 16

config UDELAY_LAPIC_FIXED_FSB
	int
	default 100

config VGA_BIOS_FILE
	string
	default "3rdparty/mainboard/$(MAINBOARDDIR)/vbios.rom"

config FSP_FILE
	default "3rdparty/mainboard/$(MAINBOARDDIR)/vpx7664_fsp-2014-12-16.bin"

config MAINBOARD_POWER_ON_AFTER_POWER_FAIL
	bool
	default y

endif # BOARD_INTEL_VPX7664
```

## src/northbridge/intel/fsp_haswell/Kconfig
```kconfig
##
## This file is part of the coreboot project.
##
## Copyright (C) 2010 Google Inc.
##
## This program is free software; you can redistribute it and/or modify
## it under the terms of the GNU General Public License as published by
## the Free Software Foundation; version 2 of the License.
##
## This program is distributed in the hope that it will be useful,
## but WITHOUT ANY WARRANTY; without even the implied warranty of
## MERCHANTABILITY or FITNESS FOR A PARTICULAR PURPOSE.  See the
## GNU General Public License for more details.
##
## You should have received a copy of the GNU General Public License
## along with this program; if not, write to the Free Software
## Foundation, Inc.
##

config NORTHBRIDGE_INTEL_FSP_HASWELL
	bool
	select CACHE_MRC_BIN
	select CPU_INTEL_FSP_HASWELL
	#select REQUIRES_BLOB
	select MMCONF_SUPPORT
	select MMCONF_SUPPORT_DEFAULT
	select INTEL_DDI
	select INTEL_DP
	select PER_DEVICE_ACPI_TABLES
	select INTEL_GMA_ACPI

if NORTHBRIDGE_INTEL_FSP_HASWELL


config VGA_BIOS_ID
	string
	default "8086,0416"

config CACHE_MRC_SIZE_KB
	int
	default 512

# FIXME: build from rom size
config MRC_CACHE_BASE
	hex
	default 0xff800000

config MRC_CACHE_LOCATION
	hex
	default 0x7fe000

config MRC_CACHE_SIZE
	hex
	default 0xf000

config DCACHE_RAM_BASE
	hex
	# use 0xff7c0000 to make pre-migration CAR vars work (romsatge)
	#default 0xff7c0000
	# use 0xfef00000 for post-migration CAR (ramstage)
	default 0xfef00000

config DCACHE_RAM_SIZE
	hex
	default 0x10000
	help
	  The size of the cache-as-ram region required during bootblock
	  and/or romstage. Note DCACHE_RAM_SIZE and DCACHE_RAM_MRC_VAR_SIZE
	  must add up to a power of 2.

config DCACHE_RAM_MRC_VAR_SIZE
	hex
	default 0x30000
	help
	  The amount of cache-as-ram region required by the reference code.

config DCACHE_RAM_ROMSTAGE_STACK_SIZE
	hex
	default 0x2000
	help
	  The amount of anticipated stack usage from the data cache
	  during pre-ram rom stage execution.

config CBFS_SIZE
	hex "Size of CBFS filesystem in ROM"
	default 0x100000
	help
	  On Haswell systems the firmware image has to store a lot more
	  than just coreboot, including:
	   - a firmware descriptor
	   - Intel Management Engine firmware
	   - MRC cache information
	  This option allows to limit the size of the CBFS portion in the
	  firmware image.

config PRE_GRAPHICS_DELAY
	int "Graphics initialization delay in ms"
	default 0
	help
	  On some systems, coreboot boots so fast that connected monitors
	  (mostly TVs) won't be able to wake up fast enough to talk to the
	  VBIOS. On those systems we need to wait for a bit before executing
	  the VBIOS.

endif
```
